## config-sets/snort-defender/defconfig
```kconfig
# Snort defender baseline for buildroot-builder2 and v86.
# Validated against Buildroot 2025.02.15.
BR2_TOOLCHAIN_BUILDROOT_GLIBC=y
BR2_INIT_BUSYBOX=y
BR2_TARGET_GENERIC_HOSTNAME="snort"
BR2_TARGET_GENERIC_ISSUE="Welcome to the Snort defender VM"
BR2_TARGET_GENERIC_GETTY=y
BR2_TARGET_GENERIC_GETTY_PORT="ttyS0"
BR2_TARGET_GENERIC_GETTY_BAUDRATE_115200=y
BR2_TARGET_GENERIC_GETTY_TERM="vt100"
BR2_SYSTEM_DHCP=""
BR2_ROOTFS_DEVICE_CREATION_DYNAMIC_EUDEV=y

BR2_LINUX_KERNEL_CUSTOM_CONFIG_FILE="../../../config-common/snort-linux.config"
BR2_LINUX_KERNEL_BZIMAGE=y

# BR2_TARGET_ROOTFS_EXT2 is not set
# BR2_TARGET_ROOTFS_TAR is not set
```
